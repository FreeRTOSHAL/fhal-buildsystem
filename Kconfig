## Kconfig
```kconfig
source arch/Kconfig
source mach/Kconfig
source driver/Kconfig
source freertos/Kconfig
menu "Compiler Settings"
config CROSS_COMPILE
	string "Cross-compiler tool prefix"
	help
	  Same as running 'make CROSS_COMPILE=prefix-' but stored for
	  default make runs in this kernel build directory.  You don't
	  need to set this unless you want the configured kernel build
	  directory to select the cross-compiler automatically.
config EXTRA_AFLAGS
	string "Extra AFLAGS"
	help
	  Same as running 'make EXTRA_AFLAGS=' but stoted for default make runs in this kernel build directory. 
	  You don't need to set this unless you want the configured kernel build dictory to select the cross-compiler
	  automaticlly. 
config EXTRA_CFLAGS
	string "Extra CFLAGS"
	help
	  Same as running 'make EXTRA_AFLAGS=' but stoted for default make runs in this kernel build directory. 
	  You don't need to set this unless you want the configured kernel build dictory to select the cross-compiler
	  automaticlly. 
config EXTRA_CPPFLAGS
	string "Extra CPPFLAGS"
	help
	  Same as running 'make EXTRA_AFLAGS=' but stoted for default make runs in this kernel build directory. 
	  You don't need to set this unless you want the configured kernel build dictory to select the cross-compiler
	  automaticlly. 
config EXTRA_LDFLAGS
	string "Extra LDFLAGS"
	help
	  Same as running 'make EXTRA_AFLAGS=' but stoted for default make runs in this kernel build directory. 
	  You don't need to set this unless you want the configured kernel build dictory to select the cross-compiler
	  automaticlly. 
endmenu
```

## Kconfig.projekt
```kconfig
source arch/Kconfig
source mach/Kconfig
source driver/Kconfig
source freertos/Kconfig
menu "Compiler Settings"
config CROSS_COMPILE
	string "Cross-compiler tool prefix"
	help
	  Same as running 'make CROSS_COMPILE=prefix-' but stored for
	  default make runs in this kernel build directory.  You don't
	  need to set this unless you want the configured kernel build
	  directory to select the cross-compiler automatically.
config DEBUG
	bool "Add Debuging"
	default n
	help
		Add Debuging Option
choice
	prompt "Optimization Option"
	config OPTIMIZATION_O0
		bool "Disable Optimization"
	config OPTIMIZATION_O1
		bool "Optimization(-O1)"
	config OPTIMIZATION_O2
		bool "Optimization(-O2)"
	config OPTIMIZATION_O3
		bool "Optimization(-O3)"
	config OPTIMIZATION_Ofast
		bool "Optimization(-Ofast) for Fast Execution"
	config OPTIMIZATION_Os
		bool "Optimization(-Os) for size"
endchoice
config REMOVE_UNUSED_SECTIONS
	bool "Remove Unused Symbols"
	default n
	help
		Remove Unused Symbols to reduce bin size

		-fdata-sections -ffunction-sections and -Wl,--gc-sections is in used
config EXTRA_AFLAGS
	string "Extra AFLAGS"
	help
	  Same as running 'make EXTRA_AFLAGS=' but stoted for default make runs in this kernel build directory. 
	  You don't need to set this unless you want the configured kernel build dictory to select the cross-compiler
	  automaticlly. 
config EXTRA_CFLAGS
	string "Extra CFLAGS"
	help
	  Same as running 'make EXTRA_AFLAGS=' but stoted for default make runs in this kernel build directory. 
	  You don't need to set this unless you want the configured kernel build dictory to select the cross-compiler
	  automaticlly. 
config EXTRA_CPPFLAGS
	string "Extra CPPFLAGS"
	help
	  Same as running 'make EXTRA_AFLAGS=' but stoted for default make runs in this kernel build directory. 
	  You don't need to set this unless you want the configured kernel build dictory to select the cross-compiler
	  automaticlly. 
config EXTRA_LDFLAGS
	string "Extra LDFLAGS"
	help
	  Same as running 'make EXTRA_AFLAGS=' but stoted for default make runs in this kernel build directory. 
	  You don't need to set this unless you want the configured kernel build dictory to select the cross-compiler
	  automaticlly. 
endmenu
```
